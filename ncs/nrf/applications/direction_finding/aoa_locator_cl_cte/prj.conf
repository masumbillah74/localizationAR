## CMakeLists.txt
```
# SPDX-License-Identifier: Apache-2.0

cmake_minimum_required(VERSION 3.13.1)
include($ENV{ZEPHYR_BASE}/cmake/app/boilerplate.cmake NO_POLICY_SCOPE)
project("aoa_locator_cl" VERSION 0.1)

set(NRF_SUPPORTED_BUILD_TYPES
  ZDebug
  ZRelease
  )

if (NOT CMAKE_BUILD_TYPE)
  set(CMAKE_BUILD_TYPE ZDebug)
endif()

zephyr_compile_definitions(
   ARM_MATH_CM4
)

zephyr_include_directories(
    .
 )

target_sources(app PRIVATE src/main.c
	src/if.c
	src/protocol.c
	src/ble.c
	src/dfe_local_config.c
)

target_include_directories(app PRIVATE $ENV{ZEPHYR_BASE}/samples/bluetooth)
target_include_directories(app PRIVATE $ENV{ZEPHYR_BASE}/subsys/bluetooth/controller)
```

## Kconfig
```
#
# Copyright (c) 2018 Nordic Semiconductor ASA
#
# SPDX-License-Identifier: LicenseRef-BSD-5-Clause-Nordic
#

menu "Aoa Locator Connectionless CTE"

config AOA_LOCATOR_UART_PORT
	string "Name of the UART port"
	default "UART_0"

config AOA_LOCATOR_DATA_SEND_WAIT_MS
	int "Number of miliseconds to wait after data is sent over UART."
	default 40
	range 1 100
	help
		The time to wait after a data packet is send.
		It is here because of the PC tool limitations,
		to give it a time for data processing before sending next packet.

endmenu

menu "Zephyr Kernel"
source "$ZEPHYR_BASE/Kconfig.zephyr"
endmenu
```

## prj.conf
```kconfig
# General Kernel Options
CONFIG_MAIN_STACK_SIZE=2048
CONFIG_HEAP_MEM_POOL_SIZE=2048
CONFIG_SYSTEM_WORKQUEUE_STACK_SIZE=2048
CONFIG_NEWLIB_LIBC=y
CONFIG_DEBUG=y
CONFIG_DEBUG_OPTIMIZATIONS=y

# BT options
CONFIG_BT=y
CONFIG_BT_OBSERVER=y
CONFIG_BT_DEBUG_LOG=y
CONFIG_BT_CTLR=y
CONFIG_BT_CTLR_DF_SUBSYSTEM=y

# Uart driver and UART configuration
CONFIG_SERIAL=y
CONFIG_UART_NRFX=y
CONFIG_UART_INTERRUPT_DRIVEN=y

# Enable the Direction finding subsystem
CONFIG_BT_CTLR_DF_SUBSYSTEM=y
# Enable receive of CTE(DFE) extension by Bluetooth stack
CONFIG_BT_CTLR_DFE_RX=y
# Set length of CTE
CONFIG_BT_CTLR_DFE_NUMBER_OF_8US=5
# Set antennas switching time
CONFIG_BT_CTLR_DFE_SWITCH_SPACING_2US=y
# Enable regular sampling configuration
CONFIG_BT_CTLR_DFE_SAMPLE_SPACING_1US=y
CONFIG_BT_CTLR_DFE_SAMPLE_SPACING_REF_1US=y
```

## src/main.c
```c
/*
 * Copyright (c) 2020 Nordic Semiconductor ASA
 *
 * SPDX-License-Identifier: LicenseRef-BSD-5-Clause-Nordic
 */

#include <assert.h>
#include <string.h>

#include <kernel.h>
#include <zephyr/types.h>
#include <sys/printk.h>
#include <bluetooth/dfe_data.h>

#include "if.h"
#include "protocol.h"
#include "dfe_local_config.h"
#include "ble.h"

/** @brief Number of ms to wait for a data before printing no data note
 */
#define WAIT_FOR_DATA_BEFORE_PRINT (1000)

/** @brief Queue defined by BLE Controller to provide IQ samples data
 */
extern struct k_msgq df_packet_msgq;

/** @brief Main function of the example.
 *
 * The function is responsible for:
 * - initialization of UART output
 * - initialization of Direction Finding in Bluetooth stack
 * - initialization of Bluetooth stack
 * - receive DFE data from Bluetooth controller
 * - mapping received data to antenna numbers
 * - forwarding data by UART
 *
 * Following steps: data receive, mapping and their forwarding
 * is done in never ending loop.
 */
void main(void)
{
	printk("Starting AoA Locator CL!\r\n");
	/* initialize UART interface to provide I/Q samples */
	struct if_data* iface = if_initialization();

	if (iface == NULL) {
		printk("Locator stopped!\r\n");
		return;
	}

	int err;

	err = protocol_initialization(iface);
	if (err) {
		printk("Locator stopped!\r\n");
		return;
	}

	const struct dfe_sampling_config* sampl_conf = NULL;
	const struct dfe_antenna_config* ant_conf = NULL;
	const struct dfe_ant_gpio* ant_gpio = NULL;
	u8_t ant_gpio_len = 0;

	sampl_conf = dfe_get_sampling_config();
	ant_conf = dfe_get_antenna_config();
	ant_gpio_len = dfe_get_ant_gpios_config_len();
	ant_gpio = dfe_get_ant_gpios_config();

	assert(sampl_conf != NULL);
	assert(ant_conf != NULL);
	assert(ant_gpio != NULL);
	assert(ant_gpio_len != 0);

	printk("Initialize DFE\r\n");
	err = dfe_init(sampl_conf, ant_conf, ant_gpio, ant_gpio_len);
	if (err) {
		printk("Locator stopped!\r\n");
		return;
	}

	printk("Initialize Bluetooth\r\n");
	ble_initialization();

	while(1)
	{
		static struct dfe_packet df_data_packet;
		static struct dfe_mapped_packet df_data_mapped;

		memset(&df_data_packet, 0, sizeof(df_data_packet));
		memset(&df_data_mapped, 0, sizeof(df_data_mapped));
		k_msgq_get(&df_packet_msgq, &df_data_packet, K_MSEC(WAIT_FOR_DATA_BEFORE_PRINT));
		if (df_data_packet.hdr.length != 0) {
			printk("\r\nData arrived...\r\n");

			dfe_map_iq_samples_to_antennas(&df_data_mapped,
						      &df_data_packet,
						      sampl_conf, ant_conf);
			err = protocol_handling(sampl_conf, &df_data_mapped);
			if (err) {
				printk("Error in protocol handling!\r\n");
				printk("Locator stopped!\r\n");
				return;
			}
		}
		else
		{
			printk("\r\nNo data received.");
		}
		k_sleep(K_MSEC(CONFIG_AOA_LOCATOR_DATA_SEND_WAIT_MS));
	}
}
```

## src/ble.c
```c
/*
 * Copyright (c) 2020 Nordic Semiconductor ASA
 *
 * SPDX-License-Identifier: LicenseRef-BSD-5-Clause-Nordic
 */

#include <sys/printk.h>
#include <bluetooth/bluetooth.h>
#include <bluetooth/hci.h>

#include "ble.h"


int ble_initialization(void)
{
	struct bt_le_scan_param scan_param = {
		.type       = BT_HCI_LE_SCAN_PASSIVE,
		.filter_dup = BT_HCI_LE_SCAN_FILTER_DUP_DISABLE,
		.interval   = 0x0020,
		.window     = 0x0020,
	};
	int err;

	printk("[BT] Initialization started\r\n");

	err = bt_enable(NULL);
	if (err)
	{
		printk("[BT] Initialization failed (err %d)\r\n", err);
		return err;
	}

	printk("[BT] Starting scanning\r\n");
	err = bt_le_scan_start(&scan_param, NULL);
	if (err)
	{
		printk("[BT] Start scanning failed (err %d)\n", err);
		return err;
	}
	return 0;
}
```

## src/ble.h
```c
/*
 * Copyright (c) 2020 Nordic Semiconductor ASA
 *
 * SPDX-License-Identifier: LicenseRef-BSD-5-Clause-Nordic
 */


#ifndef __BLE_H
#define __BLE_H

/** @brief Initialize Bluetooth stack and starts scanning
 */
int ble_initialization();

#endif
```

## src/dfe_local_config.c
```c
/*
 * Copyright (c) 2020 Nordic Semiconductor ASA
 *
 * SPDX-License-Identifier: LicenseRef-BSD-5-Clause-Nordic
 */

#include <stddef.h>
#include <stdbool.h>
#include <assert.h>
#include <zephyr/types.h>
#include <kernel.h>
#include <nrf.h>

#include "dfe_local_config.h"

const static struct dfe_sampling_config g_sampl_config = {
	.dfe_mode = RADIO_DFEMODE_DFEOPMODE_AoA,
	.start_of_sampl = RADIO_DFECTRL1_DFEINEXTENSION_CRC,
	.number_of_8us = CONFIG_BT_CTLR_DFE_NUMBER_OF_8US,
	.en_sampling_on_crc_error = false,
	.dfe_trigger_task_only = true,
	.sampling_type = RADIO_DFECTRL1_SAMPLETYPE_IQ,
	.sample_spacing_ref = CONFIG_BT_CTLR_DFE_SAMPLE_SPACING_REF_VAL,
	.sample_spacing = CONFIG_BT_CTLR_DFE_SAMPLE_SPACING_VAL,
	.sample_offset = 1,
	.switch_spacing = CONFIG_BT_CTLR_DFE_SWITCH_SPACING_VAL,
	.switch_offset = 0,
	.guard_period_us = 4,
	.ref_period_us = 8,
};

/*
const static struct dfe_antenna_config g_ant_conf = {
		.ref_ant_idx = 11,
		.idle_ant_idx = 11,
		.ant_gpio_pattern = {0, 5, 6, 4, 9, 10, 8, 13, 14, 12, 1, 2, 0}, //12,1,2,3,4,5,6,7,8,9,10,11,12 (antenna no from nordic table)
		.ant_gpio_pattern_len = 13,
		.antennae_switch_idx = {12,1,2,10,3,9,4,8,7,6,5},
		.antennae_switch_idx_len = 11,
		.gpio = {3,4,28,29},
	};

*/

// Texas instrument antenna table
// 4 -> A2.1
// 2 -> A2.2
// 1 -> A2.3
// 12 -> A1.1
// 10 -> A1.2
// 9 -> A1.3


const static struct dfe_antenna_config g_ant_conf = {
		.ref_ant_idx = 5, //A2.3
		.idle_ant_idx = 5, //A2.3
		.ant_gpio_pattern = {12, 10, 9, 4, 2, 1}, // from TI table: antenna -> A1.1, A1.2, A1.3, A2.1, A2.2, A2.3
		.ant_gpio_pattern_len = 6,
		.antennae_switch_idx = {1,2,3,4}, // using 4 out of 6 antennas, excluded 0->A1.1 and 5-> A2.3
		.antennae_switch_idx_len = 4,
		.gpio = {3,4,28,29},
	};

const static struct dfe_ant_gpio g_gpio_conf[4] = {
		{0, 3}, {1,4}, {2, 28}, {3,29}
};

/** @brief Creates switching pattern array
 *
 * The function converts provided antenna indices into array of
 * switch patterns that will be applied by radios DFE module to switch antennas.
 *
 * @param[in,out] array			pointer where to store patterns
 * @param[in] len				Length of @p array
 * @param[in] gpio_patterns		array of GPIO patterns
 * @param[in] gpio_patterns_len	length of @p gpio_patterns
 * @param[in] switch_array		array with antenna indices
 * @param[in] switch_array_len	length of @p switch_array
 *
 * @retval 0		switch pattern array created successfully
 * @retval -EINVAL	one of pointers is NULL or one of lengths is zero
 */
static int create_switching_pattern_array(u8_t *array, u8_t len,
		const u8_t *gpio_patterns, u8_t gpio_patterns_len,
		const u8_t *switch_array, u8_t switch_array_len);

/** @brief Evaluates duration of antenna switching period
 *
 * @param[in] sampling_conf	Sampling configuration
 *
 * @return Duration in [ns]
 */
static u32_t get_switching_duration_ns(const struct dfe_sampling_config *sampling_conf);

/** @brief Converts antenna switch spacing settings value to nanoseconds.
 *
 * @param[in] spacing	Value of antenna switching setting
 *
 * @return Sample spacing in [ns]
 */
static u16_t get_switch_spacing_ns(u8_t spacing);

/** @brief Evaluates number of samples collected in reference period
 *
 * @param[in] sampling_conf	Sampling configuration
 *
 * @return Number of samples
 */
static u16_t get_ref_samples_num(const struct dfe_sampling_config* sampling_conf);

/** @brief Converts antenna switch spacing settings value to nanoseconds.
 *
 * Function verifies if oversampling is enabled. That means we would receive
 * samples during antenna switching period.
 *
 * @param[in] sampling_conf	Sampling configuration
 *
 * @retval true		If oversampling is enables
 * @retval false	If oversampling is disabled
 */
static inline bool is_oversampling_enabled(const struct dfe_sampling_config *sampling_conf);

/** @brief Provides number of effective antennas used during antenna switching
 * period.
 *
 * @param[in] sampl_conf	Sampling configuration
 *
 * @return Number of antennas used to collect IQ samples except reference period
 */
static uint8_t get_effective_ant_num(const struct dfe_sampling_config *sampling_conf);

/** @brief Provides number of samples collected in single sampling slot
 *
 * @param[in] sampl_conf	Sampling configuration
 *
 * @return Number of samples collected in sampling slot
 */
static u16_t get_sampling_slot_samples_num(const struct dfe_sampling_config *sampling_conf);

const struct dfe_sampling_config* dfe_get_sampling_config()
{
	return &g_sampl_config;
}

const struct dfe_antenna_config* dfe_get_antenna_config()
{
	return &g_ant_conf;
}

const struct dfe_ant_gpio* dfe_get_ant_gpios_config()
{
	return &g_gpio_conf[0];
}

u8_t dfe_get_ant_gpios_config_len()
{
	return ARRAY_SIZE(g_gpio_conf);
}

int dfe_init(const struct dfe_sampling_config *sampl_conf,
	     const struct dfe_antenna_config *ant_conf,
	     const struct dfe_ant_gpio *ant_gpio, u8_t ant_gpio_len)
{
	assert(sampl_conf != NULL);
	assert(ant_conf != NULL);
	assert(ant_gpio != NULL);
	assert(ant_gpio_len != 0);

	int err = 0;

	err = dfe_set_mode(sampl_conf->dfe_mode);
	if (err) {
		printk("[DFE] - DFE mode is unknown\n");
		return -EINVAL;
	}

	err = dfe_set_duration(sampl_conf->number_of_8us);
	if(err) {
		printk("Error! Number of 8us periods is out of allowed range!\r\n");
		return err;
	}

	err = dfe_set_start_point(sampl_conf->start_of_sampl);
	if(err) {
		printk("Error! DFE start point value is out of allowed range!\r\n");
		return err;
	}

	dfe_set_sample_on_crc_error(sampl_conf->en_sampling_on_crc_error);

	dfe_set_trig_dfe_start_task_only(true);

	err = dfe_set_sampling_spacing_ref(sampl_conf->sample_spacing_ref);
	if(err) {
		printk("Error! Reference sample spacing value is out of range!\r\n");
		return err;
	}
	err = dfe_set_sampling_type(sampl_conf->sampling_type);
	if(err) {
		printk("Error! Sampling type value is out of range!\r\n");
		return err;
	}
	err = dfe_set_sample_spacing(sampl_conf->sample_spacing);
	if(err) {
		printk("Error! Sample spacing value is out of range!\r\n");
		return err;
	}
	err = dfe_set_backoff_gain(0);
	if(err) {
		printk("Error! Gain backoff value is out of range!\r\n");
		return err;
	}
	err = dfe_set_switch_offset(sampl_conf->switch_offset);
	if(err) {
		printk("Error! Switch offset value is out of range!\r\n");
		return err;
	}
	err = dfe_set_sample_offset(sampl_conf->sample_offset);
	if(err) {
		printk("Error! Sampling offset value is out of range!\r\n");
		return err;
	}

	err = dfe_set_ant_switch_spacing(sampl_conf->switch_spacing);
	if(err) {
		printk("Error! Antenna switch spacing is out of range!\r\n");
		return err;
	}

	err = dfe_set_ant_gpios(ant_gpio, ant_gpio_len);
	if(err) {
		printk("Error! Number of GPIO for antennas switching is to large!\r\n");
		return err;
	}

	u8_t pattern_array[ant_conf->antennae_switch_idx_len];
	err = create_switching_pattern_array(pattern_array,
				       ant_conf->antennae_switch_idx_len,
				       ant_conf->ant_gpio_pattern,
				       ant_conf->ant_gpio_pattern_len,
				       ant_conf->antennae_switch_idx,
				       ant_conf->antennae_switch_idx_len);
	if(err) {
		printk("Error! Preparation of switch patterns array failed!\r\n");
		return err;
	}

	err = dfe_set_ant_gpio_patterns(ant_conf->ant_gpio_pattern[ant_conf->idle_ant_idx],
					ant_conf->ant_gpio_pattern[ant_conf->ref_ant_idx],
					pattern_array,
					ant_conf->antennae_switch_idx_len);
	if(err) {
		printk("Error! Initialization of gpio patterns failed!\r\n");
		return err;
	}
	return 0;
}

void dfe_map_iq_samples_to_antennas(struct dfe_mapped_packet *mapped_data,
				  const struct dfe_packet *raw_data,
				  const struct dfe_sampling_config *sampling_conf,
				  const struct dfe_antenna_config *ant_config)
{
	assert(raw_data != NULL);
	assert(mapped_data != NULL);

	u16_t ref_samples_num = get_ref_samples_num(sampling_conf);
	mapped_data->ref_data.antenna_id = ant_config->ref_ant_idx;

	for(uint16_t idx = 0; idx < ref_samples_num; ++idx) {
		mapped_data->ref_data.data[idx].i = raw_data->data[idx].iq.i;
		mapped_data->ref_data.data[idx].q = raw_data->data[idx].iq.q;
	}
	mapped_data->ref_data.samples_num = ref_samples_num;

	/* Depending on DFE duration, the number of antennas used for sample
	 * may be greater than the number of antennas in configuration.
	 * If there is time left after end of antennas sequence, then radio
	 * starts to use the same antennas again.
	 */
	u16_t effective_ant_num = get_effective_ant_num(sampling_conf);

	u8_t samples_num = get_sampling_slot_samples_num(sampling_conf);

	u8_t effective_sample_idx;

	bool oversampl = is_oversampling_enabled(sampling_conf);

	if (oversampl) {
		effective_ant_num = (effective_ant_num*2);
	}

	for(u16_t ant_idx = 0; ant_idx < effective_ant_num; ++ant_idx) {
		u8_t ant;
		struct dfe_samples *sample = &mapped_data->sampl_data[ant_idx];

		if (oversampl) {
			if (ant_idx & 0x1) {
				ant = 255;
			} else {
				u8_t idx = (ant_idx >> 1) % ant_config->antennae_switch_idx_len;
				ant = ant_config->antennae_switch_idx[idx];
			}
		} else {
			u8_t idx = ant_idx % ant_config->antennae_switch_idx_len;
			ant = ant_config->antennae_switch_idx[idx];
		}

		sample->antenna_id = ant;

		for(u8_t sample_idx = 0; sample_idx < samples_num; ++sample_idx) {
			effective_sample_idx = ref_samples_num + (ant_idx * samples_num) + sample_idx;
			sample->data[sample_idx].i = raw_data->data[effective_sample_idx].iq.i;
			sample->data[sample_idx].q = raw_data->data[effective_sample_idx].iq.q;
		}
		sample->samples_num = samples_num;
	}

	mapped_data->header.length = effective_ant_num;
	mapped_data->header.frequency = raw_data->hdr.frequency;
}


static int create_switching_pattern_array(u8_t *array, u8_t len,
					  const u8_t *gpio_patterns,
					  u8_t gpio_patterns_len,
					  const u8_t *switch_array,
					  u8_t switch_array_len)
{

	if (array == NULL || len == 0 || gpio_patterns == NULL ||
	    gpio_patterns_len == 0 || switch_array == NULL ||
	    switch_array_len == 0 || len < switch_array_len) {
		return -EINVAL;
	}

	for (u8_t idx = 0; idx < switch_array_len; ++idx) {
		if (switch_array[idx] >= gpio_patterns_len)
			return -ERANGE;
	}

	for (u8_t idx = 0; idx < len; ++idx) {
		array[idx] = gpio_patterns[switch_array[idx]];
	}

	return 0;
}

static u32_t get_switching_duration_ns(const struct dfe_sampling_config *sampling_conf)
{
	assert(sampling_conf != NULL);

	u32_t swiching_duration_us = ((sampling_conf->number_of_8us * DFE_US(8)) -
			(sampling_conf->guard_period_us + sampling_conf->ref_period_us));

	return (swiching_duration_us * DFE_NS(1000));
}

static uint8_t get_effective_ant_num(const struct dfe_sampling_config *sampling_conf)
{
	assert(sampling_conf != NULL);

	u32_t switching_duration_ns = get_switching_duration_ns(sampling_conf);
	u32_t switch_spacing_ns = get_switch_spacing_ns(sampling_conf->switch_spacing);

	return (uint8_t)(switching_duration_ns / switch_spacing_ns);
}

static u16_t get_switch_spacing_ns(u8_t spacing) {

	u16_t spacing_ns = 0;
	switch(spacing) {
		case 0:
			spacing_ns = DFE_NS(8000);
			break;
		case RADIO_DFECTRL1_TSWITCHSPACING_4us:
			spacing_ns = DFE_NS(4000);
			break;
		case RADIO_DFECTRL1_TSWITCHSPACING_2us:
			spacing_ns = DFE_NS(2000);
			break;
		case RADIO_DFECTRL1_TSWITCHSPACING_1us:
			spacing_ns = DFE_NS(1000);
			break;
		default:
			return -1;
	}
	return spacing_ns;
}

u16_t dfe_get_sample_spacing_ns(u8_t sampling)
{
	u16_t sampling_ns = 0;
	switch(sampling) {
		case RADIO_DFECTRL1_TSAMPLESPACING_4us:
			sampling_ns = DFE_NS(4000);
			break;
		case RADIO_DFECTRL1_TSAMPLESPACING_2us:
			sampling_ns = DFE_NS(2000);
			break;
		case RADIO_DFECTRL1_TSAMPLESPACING_1us:
			sampling_ns = DFE_NS(1000);
			break;
		case RADIO_DFECTRL1_TSAMPLESPACING_500ns:
			sampling_ns = DFE_NS(500);
			break;
		case RADIO_DFECTRL1_TSAMPLESPACING_250ns:
			sampling_ns = DFE_NS(250);
			break;
		case RADIO_DFECTRL1_TSAMPLESPACING_125ns:
			sampling_ns = DFE_NS(125);
			break;
		default:
			sampling_ns = -1;
	}
	return sampling_ns;
}

u16_t dfe_get_sample_spacing_ref_ns(u8_t sampling) {

	u16_t sampling_ns = 0;
	switch(sampling) {
		case RADIO_DFECTRL1_TSAMPLESPACINGREF_4us:
			sampling_ns = DFE_NS(4000);
			break;
		case RADIO_DFECTRL1_TSAMPLESPACINGREF_2us:
			sampling_ns = DFE_NS(2000);
			break;
		case RADIO_DFECTRL1_TSAMPLESPACINGREF_1us:
			sampling_ns = DFE_NS(1000);
			break;
		case RADIO_DFECTRL1_TSAMPLESPACINGREF_500ns:
			sampling_ns = DFE_NS(500);
			break;
		case RADIO_DFECTRL1_TSAMPLESPACINGREF_250ns:
			sampling_ns = DFE_NS(250);
			break;
		case RADIO_DFECTRL1_TSAMPLESPACINGREF_125ns:
			sampling_ns = DFE_NS(125);
			break;
		default:
			sampling_ns = -1;
	}
	return sampling_ns;
}

static u16_t get_sampling_slot_samples_num(const struct dfe_sampling_config *sampling_conf)
{
	assert(sampling_conf != NULL);

	u16_t sample_spacing_ns = dfe_get_sample_spacing_ns(sampling_conf->sample_spacing);
	u16_t swich_spacing_ns = get_switch_spacing_ns(sampling_conf->switch_spacing);
	/* Switch spacing time is a duration between antenna switch so it holds
	 * swich slot and sample slot. Because of that in case of over sampling
	 * we take as valid samples only half of them. In case sampling duration
	 * is greater or equal all samples are valid.
	 * of
	 */
	assert(sample_spacing_ns != 0);

	if (swich_spacing_ns > sample_spacing_ns) {
		return swich_spacing_ns / (sample_spacing_ns * 2);
	} else {
		return sample_spacing_ns / sample_spacing_ns;
	}
}

static u16_t get_ref_samples_num(const struct dfe_sampling_config* sampling_conf)
{
	assert(sampling_conf != NULL);

	u16_t sample_spacing_ns = dfe_get_sample_spacing_ref_ns(sampling_conf->sample_spacing_ref);
	return sampling_conf->ref_period_us * DFE_NS(1000) / sample_spacing_ns;
}

static inline bool is_oversampling_enabled(const struct dfe_sampling_config *sampling_conf)
{
	assert(sampling_conf != NULL);

	if (sampling_conf->switch_spacing > sampling_conf->sample_spacing) {
		return false;
	} else {
		return true;
	}
}

u16_t dfe_delay_before_first_sampl(const struct dfe_sampling_config* sampling_conf)
{
	assert(sampling_conf != NULL);

	u16_t swich_spacing_ns = get_switch_spacing_ns(sampling_conf->switch_spacing);
	u16_t ref_spacing_ns = dfe_get_sample_spacing_ref_ns(sampling_conf->sample_spacing_ref);

	assert(swich_spacing_ns != 0);
	return (swich_spacing_ns >> 1) + ref_spacing_ns;
}
```

## src/dfe_local_config.h
```c
/*
 * Copyright (c) 2020 Nordic Semiconductor ASA
 *
 * SPDX-License-Identifier: LicenseRef-BSD-5-Clause-Nordic
 */


#ifndef SRC_DFE_LOCAL_CONFIG_H_
#define SRC_DFE_LOCAL_CONFIG_H_

#include <bluetooth/dfe_config.h>
#include <bluetooth/dfe_data.h>
#include "dfe_samples_data.h"

#define DFE_NS(ns)	(ns)
#define DFE_US(us)	(us)

/** @brief DFE antennas switching configuration structure
 */
struct dfe_antenna_config{
	/** Index of antenna used for reference period */
	u8_t ref_ant_idx;
	/** Index of antenna used at start of CTE and after end of CTE
	* (suggested to use the same antenna as for ref period)
	* */
	u8_t idle_ant_idx;
	 /** The array stores values that should be set to GPIO to enable antenna
	 * with given index. The index of the particular value is the antenna
	 * number. Single bit of the value is set as a value for single GPIO pin.
	 */
	u8_t ant_gpio_pattern[16];
	u8_t ant_gpio_pattern_len;
	/**Array stores indices of antennas to be enabled in particular switch state.
	 * The array does not include reference period antenna and idle antenna.
	 */
	u8_t antennae_switch_idx[48];
	u8_t antennae_switch_idx_len;
	/** GPIOS used to switch antennae. */
	u32_t gpio[8];
};

/** @brief DFE Sampling configuration structure
 */
struct dfe_sampling_config {
	/** Mode of DFE, currently we support on AoA */
	u8_t dfe_mode;
	/** Start point when CTE is added and start point when switching/sampling
	 * is done: after CRC, during packet payload
	 */
	u8_t start_of_sampl;
	/** Length of AoA/AoD procedure in number of 8[us] */
	u8_t number_of_8us;
	/** Process sampling even if CRC error occurs */
	bool en_sampling_on_crc_error;
	/** Limits start DFE to be triggered by TASKS_DFESTART only */
	bool dfe_trigger_task_only;
	/** Type of samples: I/Q or magnitude/phase */
	u8_t sampling_type;
	/** Interval between samples in REFERENCE period */
	u8_t sample_spacing_ref;
	/** Interval between samples in SWITCH period */
	u8_t sample_spacing;
	/** Time delay relative to beginning of reference period before starting
	 * sampling, number of 16M cycles ?
	 */
	s16_t sample_offset;
	/** Time between consecutive antenna switches in SWITCH period of CTE */
	u16_t switch_spacing;
	/** Time delay after end of CRC before starting switching, number of 16M cycles */
	s16_t switch_offset;
	/** Length of guard period - BT defines that to be 4[us] */
	u8_t guard_period_us;
	/** length of reference period - BT defines that to be 8[us] */
	u8_t ref_period_us;
};

/** @brief Returns instance of DFE sampling configuration data structure.
 *
 * @return instance of sampling configuration
 */
const struct dfe_sampling_config *dfe_get_sampling_config();

/** @brief Returns instance of DFE sampling configuration data structure.
 *
 * @return instance of sampling configuration
 */
const struct dfe_antenna_config *dfe_get_antenna_config();

/** @brief Returns configuration of GPIOs that should be used to drive antenna
 * switching by DFE module.
 *
 * @return pointer to GPIOs array
 */
const struct dfe_ant_gpio* dfe_get_ant_gpios_config();

/** @brief Returns length of array returned by @ref dfe_get_ant_gpios_config
 *
 * @return length of array of GPIOs to drive antenna switches
 */
u8_t dfe_get_ant_gpios_config_len();

/** @brief Initializes DFE in Bluetooth controller
 *
 * @param[in] sampl_conf	Sampling configuration
 * @param[in] ant_conf		Antenna switching configuration
 * @param[in] ant_gpio		Array of GPIOs to use to drive antenna switches
 * @param[in] ant_gpio_len	Length of @p ant_gpio array
 *
 * @return Returns zero if DFE is initialized successfully, non zero value in
 * 		   other case.
 */
int dfe_init(const struct dfe_sampling_config *sampl_conf,
	     const struct dfe_antenna_config *ant_conf,
	     const struct dfe_ant_gpio *ant_gpio, u8_t ant_gpio_len);

/** @brief Maps IQ samples to antennas.
 *
 * Maps IQ samples to antennas used to collect particular samples.
 * Radio provides raw IQ samples without information about time and antenna
 * used to collect them.
 *
 * @param[out] 	mapped_data	Storage for mapped IQ samples
 * @param[in] 	raw_data	Raw IQ samples received from BLE controller
 * @param[in] 	sampl_conf	Sampling configuration
 * @param[in] 	ant_conf	Antenna switching configuration
 */
void dfe_map_iq_samples_to_antennas(struct dfe_mapped_packet *mapped_data,
				  const struct dfe_packet *raw_data,
				  const struct dfe_sampling_config *sampling_conf,
				  const struct dfe_antenna_config *ant_config);

/** @brief Evaluates delay between last reference sample and first sample in
 * antenna switching period.
 *
 * @param[in] sampling_conf	Sampling configuration data
 *
 * @return	Time delay in [ns]
 */
u16_t dfe_delay_before_first_sampl(const struct dfe_sampling_config* sampling_conf);
/** @brief Converts sample spacing settings value to nanoseconds.
 *
 * @param[in] sampling	Spacing configuration value
 *
 * @return Sample spacing in [ns]
 */
u16_t dfe_get_sample_spacing_ns(u8_t sampling);
/** @brief Converts reference sample spacing settings value to nanoseconds.
 *
 * @param[in] sampling	Sampling configuration value
 *
 * @return Sample spacing in [ns]
 */
u16_t dfe_get_sample_spacing_ref_ns(u8_t sampling);
#endif /* SRC_DFE_LOCAL_CONFIG_H_ */
```

## src/dfe_samples_data.h
```c
/*
 * Copyright (c) 2020 Nordic Semiconductor ASA
 *
 * SPDX-License-Identifier: LicenseRef-BSD-5-Clause-Nordic
 */

#ifndef SRC_DFE_SAMPLES_DATA_H_
#define SRC_DFE_SAMPLES_DATA_H_

#include <stdint.h>
#include <bluetooth/dfe_data.h>

/** @brief IQ samples package header structure
 */
struct dfe_header {
	uint32_t length;
	uint32_t frequency;
} __attribute__((packed));

/** @brief IQ sample data structure
 *
 * The data are stored as a union.
 * Second member data is an array that is a helper used by math ARM functions.
 */
union dfe_iq_f {
	struct {
		float i; //!< 12bit
		float q; //!< 12bit
	};
	float data[2];
} __attribute__((packed));

/* Max length of SWITH PERIOD supported by our radio is 8us.
 * Smallest samples spacing is 125ns.
 * Max total number of gathered samples is 32 (that includes only sampling slots)
 */
#define DF_SAMPLES_COUNT (32)

/** @brief IQ samples collected for single antenna data structure
 *
 */
struct dfe_samples {
	union dfe_iq_f data[DFE_SAMPLES_PER_SLOT_NUM];
	uint8_t samples_num;
	uint8_t antenna_id;
} __attribute__((packed));

/** @brief IQ samples collected during reference period
 *
 * This structure differs from @see dfe_samples by size of data array.
 * Number of samples in reference period is bigger than number of samples
 * for single antenna in switching period.
 */
struct dfe_ref_samples {
	union dfe_iq_f data[DFE_REF_SAMPLES_NUM];
	uint8_t samples_num;
	uint8_t antenna_id;
} __attribute__((packed));


/* Max length of CTE is 160us. With removed guard period(4us) and reference period(8us)
 * we have 148us. Smallest reasonable antenna switching period is 2us.
 * That gives us up to 74 samples set per antenna.
 */
#define DF_MAX_EFFECTIVE_ANT_COUNT (32)
/** @brief Single DFE IQ samples mapped to antennas
 *
 * The structure holds data for a single DFE run.
 * It consists of a header, reference period IQ samples and
 * antenna switching period IQ samples.
 */
struct dfe_mapped_packet {
	struct dfe_header header;
	struct dfe_ref_samples ref_data;
	struct dfe_samples sampl_data[DFE_TOTAL_SLOTS_NUM];
} __attribute__((packed));

#endif /* SRC_DFE_SAMPLES_DATA_H_ */
```

## src/if.c
```c
/*
 * Copyright (c) 2020 Nordic Semiconductor ASA
 *
 * SPDX-License-Identifier: LicenseRef-BSD-5-Clause-Nordic
 */

#include <errno.h>
#include <device.h>
#include <drivers/uart.h>

#include "if.h"

/** @brief Storage for internals of output interface handling functionality */
static struct if_data g_if;

/** @brief UART ISR handler.
 *
 * The function is responsible for a logging information if
 * UART is interrupted when TX is ready.
 *
 * @param[in] dev	UARD device
 */
static void if_uart_app_isr(struct device *dev);

/** @brief Send data via UART
 *
 * @param[in] buffer	Data to be send
 * @param[in] length	Size of memory in @p buffer
 */
static void uart_send(uint8_t *buffer, uint16_t length);

struct if_data *if_initialization(void)
{
	g_if.dev = device_get_binding(CONFIG_AOA_LOCATOR_UART_PORT);
	if (!g_if.dev) {
		printk("[UART] - Device not found or cannot be used\r\n");
		return NULL;
	}

	uart_irq_rx_disable(g_if.dev);
	uart_irq_tx_disable(g_if.dev);
	uart_irq_callback_set(g_if.dev, if_uart_app_isr);
	uart_irq_rx_enable(g_if.dev);

	g_if.send = uart_send;

	return &g_if;
}

static void if_uart_app_isr(struct device *dev)
{
	while (uart_irq_update(dev) && uart_irq_is_pending(dev))
	{
		if (!uart_irq_rx_ready(dev))
		{
			if (uart_irq_tx_ready(dev))
			{
				printk("[UART] - transmit ready");
			}
			else
			{
				printk("[UART] - spurious interrupt");
			}

			break;
		}
	}
}

static void uart_send(uint8_t *buffer, uint16_t length)
{
	size_t i = 0;

	for(i=0; i<length; i++)
	{
		uart_poll_out(g_if.dev, buffer[i]);
	}
}
```

## src/if.h
```c
/*
 * Copyright (c) 2020 Nordic Semiconductor ASA
 *
 * SPDX-License-Identifier: LicenseRef-BSD-5-Clause-Nordic
 */

#ifndef __IF_H
#define __IF_H

/** @brief Output buffer size
 */
#define IF_BUFFER_SIZE		2048

/* Zephyrs device structure forward declaration */
struct device;

/* @brief Output interface data structure
 */
struct if_data
{
	/** Pointer to device driver */
	struct device *dev;
	/** output transfer buffer */
	u8_t tx_buffer[IF_BUFFER_SIZE];
	/** Index of last stored byte in transfer buffer */
	u16_t tx_index;
	/** callback to send data */
	void (*send)(u8_t *, u16_t);
};

/* @brief Initializes output interface
 *
 * @return pointer to output interface structure instance
 */
struct if_data* if_initialization(void);

#endif
```

## src/protocol.c
```c
/*
 * Copyright (c) 2018 Nordic Semiconductor ASA
 *
 * SPDX-License-Identifier: LicenseRef-BSD-5-Clause-Nordic
 */

#include <stddef.h>
#include <stdio.h>
#include <string.h>
#include <errno.h>
#include <assert.h>

#include <sys/printk.h>

#include "protocol.h"
#include "if.h"

#define SAMPLING_TIME_UNIT (125) //!< smallest possible time between samples [ns]

static struct protocol_data g_protocol_data;

static uint16_t protocol_convert_to_string(const struct dfe_sampling_config* sampl_conf,
					   const struct dfe_mapped_packet *mapped_data,
					   char *buffer, uint16_t length);

int protocol_initialization(struct if_data* iface)
{
	if (iface == NULL) {
		printk("[PROTOCOL] - iface is NULL, cannot initialize\r\n");
		return -EINVAL;
	}

	g_protocol_data.uart = iface;
	return 0;
}

int protocol_handling(const struct dfe_sampling_config *sampl_conf,
		      const struct dfe_mapped_packet *mapped_data)
{
	assert(sampl_conf != NULL);
	assert(mapped_data != NULL);
	uint16_t length = 0;

	length = protocol_convert_to_string(sampl_conf, mapped_data,
					    g_protocol_data.string_packet,
					    PROTOCOL_STRING_BUFFER_SIZE);
	g_protocol_data.uart->send(g_protocol_data.string_packet, length);

	return 0;
}

/** @brief Converts provided IQ samples into string
 *
 * The function stores provided IQ samples into a buffer.
 * Format of a stored data is fixed:
 * - header
 * - sampling settings
 * - not used fields for evaluated angles
 * - IQ samples
 * - footer
 *
 * @param[in]		sampl_config	Configuration of sampling
 * @param[in]		mapped_data	IQ	samples mapped to antennas
 * @param[in,out]	buffer			Memory to store string representation
 * @param[in] 		len				length of memory provided by @p buffer
 *
 * @return Number of characters stored in transmission buffer.
 */
static u16_t protocol_convert_to_string(const struct dfe_sampling_config* sampl_conf,
					   const struct dfe_mapped_packet *mapped_data,
					   char *buffer, uint16_t length)
{
	printk("DF_BEGIN\r\n");
	u16_t strlen = sprintf(buffer, "DF_BEGIN\r\n");

	strlen += sprintf(&buffer[strlen], "SW:%d\r\n", (int)sampl_conf->switch_spacing);
	strlen += sprintf(&buffer[strlen], "RR:%d\r\n", (int)sampl_conf->sample_spacing_ref);
	strlen += sprintf(&buffer[strlen], "SS:%d\r\n", (int)sampl_conf->sample_spacing);
	strlen += sprintf(&buffer[strlen], "FR:%d\r\n", (int)mapped_data->header.frequency);

	strlen += sprintf(&buffer[strlen], "ME:%d\r\n", (int)0);
	strlen += sprintf(&buffer[strlen], "MA:%d\r\n", (int)0);
	strlen += sprintf(&buffer[strlen], "KE:%d\r\n", (int)0);
	strlen += sprintf(&buffer[strlen], "KA:%d\r\n", (int)0);

	u16_t time_u = dfe_get_sample_spacing_ref_ns(sampl_conf->sample_spacing_ref) / SAMPLING_TIME_UNIT;
	u16_t ref_idx;

	for(ref_idx = 0; ref_idx < mapped_data->ref_data.samples_num; ++ref_idx)
	{
		strlen += sprintf(&buffer[strlen], "IQ:%d,%d,%d,%d,%d\r\n", ref_idx,
				time_u * ref_idx,
				 (int)mapped_data->ref_data.antenna_id,
				 (int)mapped_data->ref_data.data[ref_idx].q,
				 (int)mapped_data->ref_data.data[ref_idx].i);
	}
	/* compute delay  between last sample in reference period and first sample
	 * in antenna switching period.
	 */
	u16_t delay =  dfe_delay_before_first_sampl(sampl_conf) / SAMPLING_TIME_UNIT;
	delay += (time_u * (ref_idx-1));
	time_u = dfe_get_sample_spacing_ns(sampl_conf->sample_spacing) / SAMPLING_TIME_UNIT;

	for(u16_t idx=0; idx<mapped_data->header.length; ++idx)
	{
		const struct dfe_samples* sampl_data = &mapped_data->sampl_data[idx];

		for(u16_t jdx = 0; jdx < sampl_data->samples_num; ++jdx)
		{
			u16_t idx_offset = (sampl_data->samples_num * idx) + jdx;

			strlen += sprintf(&buffer[strlen], "IQ:%d,%d,%d,%d,%d\r\n", ref_idx + idx_offset,
					delay + (idx_offset) * time_u,
					 (int)sampl_data->antenna_id,
					 (int)sampl_data->data[jdx].q,
					 (int)sampl_data->data[jdx].i);
		}
	}

	strlen += sprintf(&buffer[strlen], "DF_END\r\n");

	return strlen;
}
```

## src/protocol.h
```c
/*
 * Copyright (c) 2020 Nordic Semiconductor ASA
 *
 * SPDX-License-Identifier: LicenseRef-BSD-5-Clause-Nordic
 */

#ifndef __PROTOCOL_H
#define __PROTOCOL_H

#include <zephyr/types.h>
#include <bluetooth/dfe_data.h>
#include "dfe_local_config.h"
#include "if.h"

/** @brief Header added to data message send via UART
 */
#define PROTOCOL_HEAD				"+AoA"
/** @brief Length of a string buffer used to send data via UART
 */
#define PROTOCOL_STRING_BUFFER_SIZE		10240

/** @brief UARD data transmission structure */
struct protocol_data
{
	/** @brief Member to access UARD port
	 */
	struct if_data *uart;
	/** @brief Transmission data buffer
	 */
	char string_packet[PROTOCOL_STRING_BUFFER_SIZE];
};

/** @brief Initializes data transfer internals.
 *
 * @param[in] iface Pointer to interface data
 *
 * @retval 0 successful initialization
 * @retval -EINVAL if @p iface is NULL
 */
int protocol_initialization(struct if_data *iface);

/** @brief Puts mapped IQ samples into transfer buffer.
 *
 * The function stores IQ samples including information like: mapped antenna
 * index, time delay from the beginning of CTE reception (first sample).
 * Pay attention that antenna index 255 means sample taken during switch period.
 * Time data related with particular samples is an integer value.
 * The unit of the value is 125[us]. E.g. Time 4 means 4*125=500[us].
 *
 * @param[in] smapl_conf	Pointer to sampling configuration
 * @param[in] mapped_data	Pointer to IQ samples mapped to antennas
 */
int protocol_handling(const struct dfe_sampling_config *sampl_conf,
					  const struct dfe_mapped_packet *mapped_data);
#endif
```
